#include "Arduino.h"
#include "Motor_control_jk.h"


/*    Servo/DC motor position - library for controlling a DC or servo motor position using a variable resistor 
   Created by: 

         Michal Rinott <http://people.interaction-ivrea.it/m.rinott> 

         modified on 8 Nov 2013
         by Scott Fitzgerald
         http://arduino.cc/en/Tutorial/Knob

         modified Feb 2015
         by Eamon Campolettano, Jessica Ross, Kevin Fasano, Thomas S. Todd

  All Rights Reserved
*/


// Constructor. This function runs when we provide 
Motor_control_jk::Motor_control_jk(){
    //take inputs and assign them to class-owned vars

    ftheta_1 = 0;
    ftheta_3 = 0;


}

 void Motor_control_jk::findMotor_position(float theta_ones[100], float theta_threes[100], float time[100], float currtime) 
{ 

int len = 101;
//float time_a[len_a];
//float theta_threes_a[len_a];
//float theta_ones_a[len_a];

//const float time_l[] = {5,5.0002,5.0066,5.0107,5.0135,5.0159,5.0185,5.0211,5.0241,5.0272,5.0306,5.0342,5.0378,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5.4803,5.4803};
//const float theta_ones_l[] = {-0.2278,-0.22607,-0.22536,-0.22603,-0.22738,-0.22905,-0.23076,-0.23245,-0.23408,-0.23569,-0.23724,-0.23878,-0.2403,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-0.36759,-0.36759};
//const float theta_threes_l[] = {0.29452,0.29638,0.2978,0.29921,0.30076,0.30245,0.30437,0.30632,0.30838,0.31049,0.3127,0.31495,0.31722,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0.52624,0.52624};


 //int len_o = 101;
 //const float time_o[] = {0.29452,0.29886,0.30412,0.31002,0.3158,0.32213,0.32835,0.3343,0.34037,0.3466,0.35288,0.35908,0.36499,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0.81862,0.81862};
 //const float theta_ones_o[] = {-0.2278,-0.22442,-0.22619,-0.23141,-0.23736,-0.24342,-0.2511,-0.2596,-0.26781,-0.27677,-0.28673,-0.29736,-0.30871,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-0.22823,-0.22823};
 //const float theta_threes_o[]= {0.29452,0.29831,0.28771,0.27198,0.25531,0.23842,0.21992,0.20051,0.18114,0.16092,0.13965,0.11764,0.094852,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0.31729,0.31729};

 //c
 // int len_g = 101;
  //const float time_g[] = {5,5.0526,5.1025,5.141,5.1765,5.2092,5.2398,5.2686,5.2963,5.3221,5.346,5.3711,5.4464,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8.1806,8.1806};
  //const float theta_ones_g[] = {-0.2278,-0.23181,-0.24115,-0.2537,-0.26757,-0.28417,-0.30344,-0.32527,-0.34944,-0.37579,-0.40389,-0.43352,-0.46421,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-0.55295,-0.55295};
 // const float theta_threes_g[] = {0.29452,0.28361,0.25716,0.22559,0.19229,0.15624,0.11764,0.07679,0.033988,-0.010346,-0.055676,-0.10207,-0.14822,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0.12278,0.12278};

  //switch(letter){
    //case 1 :  
    if(currtime>time[0]){
    if(currtime<time[len-1]){
      ftheta_1 = multiMap(currtime, time, theta_ones, len);
      ftheta_3 = multiMap(currtime, time, theta_threes, len);
  }
      else{
        ftheta_1 = theta_ones[len-1];
        ftheta_3 = theta_threes[len-1];
        }
      }
      else{
        ftheta_1 = theta_ones[0];
        ftheta_3 = theta_threes[0];
      }
/*     case 2:
    if(currtime>time_o[0]){
    if(currtime<time_o[len_o-1]){     
      ftheta_1 = multiMap(currtime, time_o, theta_ones_o, len_o);
      ftheta_3 = multiMap(currtime, time_o, theta_threes_o, len_o);
  }
      else{
        ftheta_1 = theta_ones_o[len_o-1];
        ftheta_3 = theta_threes_o[len_o-1];
        }
      }
      else{
        ftheta_1 = theta_ones_o[0];
        ftheta_3 = theta_threes_o[0];
      }
    case 3:
    if(currtime>time_g[0]){
    if(currtime<time_g[len_g-1]){ 
      ftheta_1 = multiMap(currtime, time_g, theta_ones_g, len_g);
      ftheta_3 = multiMap(currtime, time_g, theta_threes_g, len_g);
   }
      else{
        ftheta_1 = theta_ones_g[len_g-1];
        ftheta_3 = theta_threes_g[len_g-1];
        }
      }
      else{
        ftheta_1 = theta_ones_g[0];
        ftheta_3 = theta_threes_g[0];
      }      

        break;
  } */

  }

// note: the _in array should have increasing values
float Motor_control_jk::multiMap(float val, const float* _in, const float* _out, uint8_t size)
{Serial.print("hello \t");
  // take care the value is within range
  // val = constrain(val, _in[0], _in[size-1]);
  if (val <= _in[0]) {
    return _out[0];
 }
  
  
  if (val >= _in[size-1]){
    return _out[size-1];
    
  }
  
  // search right interval
  uint8_t pos = 1;  // _in[0] allready tested
  while(val > _in[pos]) pos++;
 
  // this will handle all exact "points" in the _in array
  if (val == _in[pos]) return _out[pos];
  // interpolate in the right segment for the rest
  return (val - _in[pos-1]) * (_out[pos] - _out[pos-1]) / (_in[pos] - _in[pos-1]) + _out[pos-1];
}