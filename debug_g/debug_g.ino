
#include <piduino.h>

#include <encod.h>
/* 
An example of using the Encod library with the PiDuino library

SEEED studio Motor Shield V2
Pololu 50:1 gearmotor with 64 CPR encoder @ 12V

Alexander Brown, Ph.D.

*/
//Because the encod library uses interrupts, its usage is a little weird.
//You have to initialize it, but then attach the interrupts yourself. You
//must create a function that handles channel A and channel B for each encoder (0,1,2) you use.
//This is not a big deal.... see below. It's still a little wonky. The reason it has to be this way
//has to do with how attachInterrupt() is written.
 
//format: Encod(interrupt number, counts_per_revolution)
Encod enc1(0,50.0*64.0);//initialize an encoder
Encod enc2(1,50.0*64.0);//other encoder
//now initialize a "servo" PID object: format is:
//Piduino(int dirpin1,int dirpin2, int speedpin, float deadband, float inkp, float inki, float inkd, float inksum)
//Piduino servo1(8,11,9,25.0,5000,100,150.0,1.0);
//Piduino servo2(12,13,10,25.0,5000,100,150.0,1.0);
Piduino servo1(8,11,9,25.0,5000,75,100.0,1.0);
Piduino servo2(12,13,10,25.0,5000,75,100.0,1.0);


//Position data along mapped 'g'
//int len = 98;
//float time[] =  {5,5.1,5.2,5.3,5.4,5.5,5.6,5.7,5.8,5.9,6,6.1,6.2,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14.8,17.0};
//float theta_ones[] = {0.23445,0.24996,0.26672,0.28392,0.30082,0.31711,0.33263,0.34687,0.36007,0.37164,0.38195,0.39037,0.39657,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0.024321,0.0};
//float theta_threes[] = {2.1874,2.1879,2.1856,2.1812,2.1755,2.1681,2.1589,2.1482,2.1365,2.1236,2.1098,2.095,2.0797,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1.8609,0.0};
//float ktheta_ones[] = {};
//float ktheta_threes[] = {};

//g from data to theta
int len = 100;
float time[] = {5,5.0526,5.1025,5.141,5.1765,5.2092,5.2398,5.2686,5.2963,5.3221,5.346,5.3711,5.4464,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8.1806,8.1806};
float theta_ones[] = {0.18413,0.18608,0.19134,0.19635,0.2012,0.20501,0.20776,0.20941,0.21002,0.20952,0.20804,0.20586,0.20263,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-0.059294,-0.059294};
float theta_threes[] = {1.3867,1.3842,1.3787,1.3719,1.365,1.3573,1.3489,1.3399,1.3304,1.3203,1.3099,1.2992,1.2883,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1.221,1.221};
float ktheta_ones[] = {0.14242,0.013581,0.17678,0.19973,0.33576,0.40383,0.41035,0.36277,0.2608,0.13116,0.027542,0.17194,0.36895,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0.033691,0.033691};
float ktheta_threes[] = {0.22374,0.065005,0.27507,0.31214,0.60671,0.9076,1.2249,1.5053,1.7897,2.0203,2.1566,2.3641,2.515,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2.2093,2.2093};

//o from data to theta 
//int len = 100;
//float time[] = {5,5.1931,5.2242,5.2519,5.2769,5.3,5.3211,5.341,5.3606,5.3795,5.3975,5.415,5.4321,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7.3904,7.3904};
//float theta_ones[] = {0.18413,0.18559,0.18975,0.19322,0.19651,0.19988,0.20253,0.20492,0.20768,0.21023,0.21242,0.21442,0.21623,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0.17078,0.17078};
//float theta_threes[] = {1.3867,1.3884,1.3869,1.3837,1.3803,1.377,1.373,1.3689,1.365,1.361,1.3567,1.3522,1.3477,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1.3883,1.3883};
//float ktheta_ones[] = {0.23445,0.24996,0.26672,0.28392,0.30082,0.31711,0.33263,0.34687,0.36007,0.37164,0.38195,0.39037,0.39657,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0.0084489,0.024321};
//float ktheta_threes[] = {2.1874,2.1879,2.1856,2.1812,2.1755,2.1681,2.1589,2.1482,2.1365,2.1236,2.1098,2.095,2.0797,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1.8693,1.8609}; 


//l from data to theta
//int len = 100;
//float time[] = {5,5.0002,5.0066,5.0107,5.0135,5.0159,5.0185,5.0211,5.0241,5.0272,5.0306,5.0342,5.0378,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5.4803,5.4803};
//float theta_ones[] = {0.18413,0.18492,0.18487,0.18335,0.18103,0.17828,0.17537,0.17247,0.16956,0.16666,0.16377,0.16088,0.15799,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-0.077637,-0.077637};
//float theta_threes[] = {1.3867,1.3875,1.3879,1.3878,1.3873,1.3867,1.3862,1.3856,1.3851,1.3846,1.3842,1.3838,1.3834,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1.3872,1.3872};
//float ktheta_ones[] = {0.23445,0.24996,0.26672,0.28392,0.30082,0.31711,0.33263,0.34687,0.36007,0.37164,0.38195,0.39037,0.39657,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0.0084489,0.024321};
//float ktheta_threes[] = {2.1874,2.1879,2.1856,2.1812,2.1755,2.1681,2.1589,2.1482,2.1365,2.1236,2.1098,2.095,2.0797,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1.8693,1.8609};


float tvector_scale = .5;



// Second Motor  
int init_1 = 0;   // analog pin used to connect the potentiometer
int val_1;        // variable to read the value from the analog pin 
int init_2 = 0;   // a
int val_2; 
float start_time = 0;//the millis() value where the trial starts.
bool go = false;
int gopin = 5;//this is the pin for a switch to start the trial.
//int theta_1 = 0;
//int theta_3 = 0; 
int L1 = 5;
int L3 = 3;

/// Stuff for filtering force sensor readings.
float tau = 0.030; //seconds, filter time constant
float dT = 0.01;// seconds, initial guess of dT
float alpha = .5; // guess for filter constant.
float sensorValue1_smooth = 0;
float sensorValue1_smooth_old = 0;
float sensorValue2_smooth = 0;
float sensorValue2_smooth_old = 0;
float sensorValue3_smooth = 0;
float sensorValue3_smooth_old = 0;

float floatpos_smooth = 0;
float floatpos_smooth_old = 0;

long reading_sum1 = 0;
long reading_sum2 = 0;
int zero_offset1;
int zero_offset2;

const float pi = 3.14159;
float ftheta_1=theta_ones[0];
float ftheta_3=theta_threes[0];
float currtime = 0;
float pos1 = 0;
float pos2 = 0;
float Fx;
float Fy;
float voltage1x;
float voltage2x;
float voltage3x;
float voltage2y;
float voltage3y;
float netx;
float nety;
float theta1star = 0;
float theta3star = 0;
float e1sqt = 0;
float e3sqt = 0;
float e_total = 0;
float T1 = 0;
float T3 = 0;
float fktheta1 = 0;
float fktheta3 = 0;


//for pausing time...
float tottheta1 = 0;
float tottheta3 = 0;
float e1 = 0;
float e3 = 0;

float ethresh = 1.3;//if error is greater than this, we will PAUSE TIME...


void setup()
{
  Serial.begin(115200);
  //you have to manually attach interrupts for each encoder (1,2,..)
  attachInterrupt(enc1._interrupt1,e1_ISRA,CHANGE);
  attachInterrupt(enc1._interrupt2,e1_ISRB,CHANGE);
  attachInterrupt(enc2._interrupt1,e2_ISRA,CHANGE);
  attachInterrupt(enc2._interrupt2,e2_ISRB,CHANGE);
}


void loop() 
{ go = digitalRead(gopin);
 
 float realtime = millis()/1000.0;
    
  int sensorValue1 = analogRead(A0);
  int sensorValue2 = analogRead(A1);
  int sensorValue3 = analogRead(A2);
  
  // We are going to try to use a low pass filter to smooth out the sensor readings
  // RC = tau = dT*(1-alpha)/alpha where alpha is between 0 and 1
  // tau is at the top of this file
  alpha = 1/(tau/dT+1);
  sensorValue1_smooth = sensorValue1_smooth_old + alpha*(sensorValue1-sensorValue1_smooth_old); 
  sensorValue1_smooth_old = sensorValue1_smooth;
  sensorValue2_smooth = sensorValue2_smooth_old + alpha*(sensorValue2-sensorValue2_smooth_old); 
  sensorValue2_smooth_old = sensorValue2_smooth;
  sensorValue3_smooth = sensorValue3_smooth_old + alpha*(sensorValue3-sensorValue3_smooth_old); 
  sensorValue3_smooth_old = sensorValue3_smooth;
  
  if(abs(e1)<=ethresh && abs(e3)<=ethresh){
  currtime = float(millis())*.001-start_time;
  currtime = currtime*tvector_scale;//this scales the time to slow down the letter.
}
else{
  Serial.println("TIME IS PAUSED DUDE");
}
  //currtime = 5.02;
//  Convert the analog reading (which goes from 0 - 1023) to a voltage (0 - 5V):
  voltage1x = float(sensorValue1_smooth)*(5/1023.0);
  voltage2x = 0.5*float(sensorValue2_smooth)*(5/1023.0);
  voltage3x = 0.5*float(sensorValue3_smooth)*(5/1023.0);
  voltage2y = (sqrt(3)/2)*float(sensorValue2_smooth)*(5/1023.0);
  voltage3y = (sqrt(3)/2)*float(sensorValue3_smooth)*(5/1023.0);
  Fx = voltage1x-voltage2x-voltage3x;
  Fy = voltage2y-voltage3y;
    
    
  if(currtime>time[0]&&currtime<time[len]){
      
  ftheta_1 = multiMap(currtime,time, theta_ones, len);
  ftheta_3 = multiMap(currtime,time, theta_threes, len);
  fktheta1 = multiMap(currtime,time,ktheta_ones,len);
  fktheta3 = multiMap(currtime,time,ktheta_threes,len);
  
  T1 = Fx*sin(ftheta_1) - Fy*cos(ftheta_1)*L1;
  T3 = -Fx*L3*cos(ftheta_3-pi/2) - Fy*L3*sin(ftheta_3-pi/2);
   
//0.015 works well for the stopped position, but not with positional control
//-0.001 to 0.001 seems to work a little bit. It can be a tad jumpy.
float k = 0.00; 
 

 theta1star = T1*k/(fktheta1);
 theta3star = T3*k/(fktheta3);
 
 //query the encoder object for its position in rad and its velocity in rad/s     
 pos1 = enc1.readPosRad();
 pos2 = enc2.readPosRad();
   
 float omega1  = enc1.readVelRad();        
 float omega2 =  enc2.readVelRad();

 tottheta1 = -ftheta_1-theta1star;//TOTAL angle sent as command to motor 1
 tottheta3 = ftheta_3-(pi/2)+theta3star;

 e1 = tottheta1-pos1;//total error now
 e3 = tottheta3-pos2;
 
//   use the PIDUINO library to write the command.
//   servo1.writePID(-ftheta_1,pos1,omega1);
//   servo2.writePID(-ftheta_3+(3.1415/2),pos2,omega2);
 servo1.writePID(tottheta1,pos1,omega1);
 servo2.writePID(tottheta3,pos2,omega2);
       
 // Calculate squared error of angular position offset from desired path 
 e1sqt += (pos1+ftheta_1)*(pos1+ftheta_1);
 e3sqt += (pos2+ftheta_3-(pi/2))*(pos2+ftheta_3-(pi/2));
 e_total = e1sqt + e3sqt;   
 
  }
  else{
    
   //query the encoder object for its position in rad and its velocity in rad/s
   pos1 = enc1.readPosRad();
   pos2 = enc2.readPosRad();
   
   float omega1  = enc1.readVelRad();        
   float omega2 =  enc2.readVelRad();
   
//   ftheta_1 = 0;
//   ftheta_3 = 3.1415/2;
   
//   servo1.writePID(-ftheta_1,pos1,omega1);
//   servo2.writePID(-ftheta_3+(3.1415/2),pos2,omega2);

//use the PIDUINO library to write the command.
  servo1.writePID(-ftheta_1-theta1star,pos1,omega1);
  servo2.writePID(ftheta_3-(pi/2)+theta3star,pos2,omega2); 
  e1sqt += 0;
  e3sqt += 0;
  e_total = e1sqt + e3sqt; 
  }
  
 // }  
// Serial.print(currtime);
// Serial.print("\t");
Serial.print(realtime,4);
Serial.print("\t");
Serial.print(ftheta_1,4);
Serial.print("\t");
 Serial.print(pos1,4);
 Serial.print("\t");
Serial.print(ftheta_3,4);
Serial.print("\t");
 Serial.print(pos2,4);
 Serial.print("\t");
Serial.print(e1,4);
 Serial.print("\t");
 Serial.print(e3,4);
 Serial.print("\t");
 Serial.print(theta1star);
 Serial.print("\t");
 Serial.print(theta3star);
 Serial.print("\t");
// Print out the force values you read:
//  Serial.print(voltage1x);  
//  Serial.print("\t");
//  Serial.print(voltage2x); 
//  Serial.print("\t");
//  Serial.print(voltage2y);
//  Serial.print("\t");
//  Serial.print(voltage3x);
//  Serial.print("\t");
//  Serial.print(voltage3y);
//  Serial.print("\t");
//  Serial.print(Fx);
//  Serial.print("\t");
//  Serial.print(Fy);
Serial.println();
delay(1);
 }
 
// note: the _in array should have increasing values
float multiMap(float val, float* _in, float* _out, uint8_t size){

  // take care the value is within range
  // val = constrain(val, _in[0], _in[size-1]);
  if (val <= _in[0]) {
    return _out[0];
 }
  if (val >= _in[size-1]){
    return _out[size-1];
  }
  // search right interval
  uint8_t pos = 1;  // _in[0] allready tested
  while(val > _in[pos]) pos++;
 
  // this will handle all exact "points" in the _in array
  if (val == _in[pos]) return _out[pos];

  // interpolate in the right segment for the rest
  return (val - _in[pos-1]) * (_out[pos] - _out[pos-1]) / (_in[pos] - _in[pos-1]) + _out[pos-1];
   float tnow = float(millis())*.001;
}
void e1_ISRA(){
  enc1.channelA();
}
void e1_ISRB(){
  enc1.channelB();
}
void e2_ISRA(){
  enc2.channelA();
}
void e2_ISRB(){
  enc2.channelB();
}
 
